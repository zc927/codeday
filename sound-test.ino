//--------------------------------------------------------------------------------------------------------DEFINE------------------------------------------------------------------------------//

#include <U8g2lib.h>
#include <AsyncDelay.h>
#include "DHT.h"

#define DHTPIN 3
#define DHTTYPE DHT11

DHT dht(DHTPIN, DHTTYPE);

AsyncDelay tick;
U8G2_SSD1306_128X64_NONAME_F_HW_I2C u8g2(U8G2_R2, SCL, SDA, U8X8_PIN_NONE);

//------------------------------------------------------------------------------------------------------------IMAGES----------------------------------------------------------------------------//

static const unsigned char bg[] U8X8_PROGMEM = {
 0xff,0xff,0xff,0xff,0xff,0xff,0xff,0xff,0xff,0xff,0xff,0xff,0xff,0xff,0xff,
 0xff,0xff,0xff,0xff,0xff,0xff,0xff,0xff,0xff,0xff,0xff,0xff,0xff,0xff,0xff,
 0xff,0xff,0xff,0xff,0xff,0xff,0xff,0xff,0xff,0xff,0xff,0xff,0xff,0xff,0xff,
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 0xff,0xff,0xff,0xff };


static const unsigned char happy_frog_a[] U8X8_PROGMEM = {
 0xff,0xff,0xff,0xff,0xff,0xff,0xff,0xff,0xff,0xff,0xff,0xff,0xff,0xff,0xff,
 0xff,0xff,0xef,0xff,0xff,0xff,0xff,0xff,0xff,0xff,0xff,0xff,0xff,0xff,0xff,
 0xff,0xff,0xff,0xe7,0xff,0xff,0xff,0xff,0xff,0xff,0xff,0xff,0xff,0xff,0xff,
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 0xff,0xff,0xff,0xff };

static const unsigned char happy_frog_b[] U8X8_PROGMEM = {
 0xff,0xff,0xff,0xff,0xff,0xff,0xff,0xff,0xff,0xff,0xff,0xff,0xff,0xff,0xff,
 0xff,0xff,0xfb,0xff,0xff,0xff,0xff,0xff,0xff,0xff,0xff,0xff,0xff,0xff,0xff,
 0xff,0xff,0xff,0xf3,0xff,0xff,0xff,0xff,0xff,0xff,0xff,0xff,0xff,0xff,0xff,
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 0xff,0xff,0xff,0xff };

static const unsigned char buttonFrog[] U8X8_PROGMEM = {
 0xff,0xff,0xff,0xff,0xff,0xff,0xff,0xff,0xff,0xff,0xff,0xff,0xff,0xff,0xff,
 0xff,0xff,0xff,0xff,0xff,0xff,0xff,0xff,0xff,0xff,0xff,0xff,0xff,0xff,0xff,
 0xff,0xff,0xff,0xff,0xff,0xff,0xff,0xff,0xff,0xff,0xff,0xff,0xff,0xff,0xff,
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 0xff,0xff,0xff,0xff };

static const unsigned char coldFrog1[] U8X8_PROGMEM = {
 0xff,0xff,0xff,0xff,0xff,0xff,0x3f,0xf8,0xff,0xff,0xff,0xff,0xff,0xff,0xff,
 0xff,0xff,0xff,0xff,0xff,0xff,0xff,0x8f,0xe3,0xff,0xff,0xff,0xff,0xff,0xff,
 0xff,0xff,0xff,0xff,0xff,0xff,0xff,0xff,0xe7,0xcf,0xff,0xff,0xff,0xff,0xff,
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 0xff,0xff,0xff,0xff };

static const unsigned char coldFrog2[] U8X8_PROGMEM = {
 0xff,0xff,0xff,0xff,0xff,0xff,0xff,0xff,0xff,0xff,0xff,0xff,0xff,0xff,0xff,
 0xff,0xff,0xff,0xff,0xff,0xff,0xff,0x3f,0xf8,0xff,0xff,0xff,0xff,0xff,0xff,
 0xff,0xff,0xff,0xff,0xff,0xff,0xff,0xff,0xc7,0xe3,0xff,0xff,0xff,0xff,0xff,
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 0xff,0xff,0xff,0xff };

//---------------------------------------------------------------------------------------------------------CONSTANTS--------------------------------------------------------------------//

#define hfrog_width 128
#define hfrog_height 64
const int fps = 0; //3-4 ish fps
const int display_width = 164;
const int crit_temp = 20;
int animate_frame = 0;
int current_pos = -display_width;
int move_int = 3; //movement interval
int delayTime = 2000; //for flower
float temp_hum[2] = {0};

char button = 6;
char led = 4;
char rotary = A0;
char sound = A2;
//char tempsensor = 3;
//-----------------------------------------------------------------------------------------------------CODING--------------------------------------------------------------//

void setup(void) {

  u8g2.begin();
  pinMode(button, INPUT);
  pinMode(led, OUTPUT);
  Serial.begin(115200);
  tick.start(fps, AsyncDelay::MILLIS);
}

void loop() {
  if (tick.isExpired()) {
  current_pos += move_int;
    if(current_pos > 2*display_width)
    {
      current_pos = .9*display_width;
    }
    if (digitalRead(button) == HIGH)
    {
      buttonPress();
    }
    if (analogRead(sound) > 380)
    {
      coldAnimate();
      //loudFrog();
    }
    else
    {
       drawFrogAnimate();
    }

    //temp and hum sensor is very slow :(
    
    /*if (!dht.readTempAndHumidity(temp_hum))
    {
      if (temp_hum[1] < crit_temp)
      {
        coldAnimate();
      } 
      else
      {
        drawFrogAnimate();
      } 
      if (animate_frame == 0)
      {
         animate_frame++;
      }
      else if (animate_frame == 1)
      {
        animate_frame--;
      }
    }*/
    if (animate_frame == 0)
      {
         animate_frame++;
      }
      else if (animate_frame == 1)
      {
        animate_frame--;
      }
    tick.repeat();
  }

} 


void drawFrogAnimate() {
  u8g2.firstPage();
  do {
    u8g2.drawXBMP(0,0, hfrog_width, hfrog_height, bg); //the background of white
    switch (animate_frame) {
      case 0:
        u8g2.drawXBMP(current_pos,0, hfrog_width, hfrog_height, happy_frog_a);
        break;
      case 1: 
        u8g2.drawXBMP(current_pos,0, hfrog_width, hfrog_height, happy_frog_b);
        break;
    }
  }
  while(u8g2.nextPage());
}

void coldAnimate() {
//cold!
u8g2.firstPage();
do {
  u8g2.drawXBMP(0,0, hfrog_width, hfrog_height, bg); //the background of white
  switch (animate_frame) {
    case 0:
      u8g2.drawXBMP(current_pos,0, hfrog_width, hfrog_height, coldFrog1);
      break;
    case 1: 
      u8g2.drawXBMP(current_pos,0, hfrog_width, hfrog_height, coldFrog2);
      break;
      }
    }
    while(u8g2.nextPage());
}

void buttonPress() {
  u8g2.firstPage();
  do {
    u8g2.drawXBMP(0,0, hfrog_width, hfrog_height, buttonFrog);
    digitalWrite(led,HIGH);
  }
  while(u8g2.nextPage());
    delay(delayTime);
    digitalWrite(led,LOW);

}
