//--------------------------------------------------------------------------------------------------------CONSTANTS------------------------------------------------------------------------------//

#include <U8g2lib.h>
#include <AsyncDelay.h>

AsyncDelay tick;
U8G2_SSD1306_128X64_NONAME_F_HW_I2C u8g2(U8G2_R2, SCL, SDA, U8X8_PIN_NONE);

#define hfrog_width 128
#define hfrog_height 64
const int fps = 200; //3-4 ish fps
int animate_frame = 0;
const int display_width = 164;
int current_pos = -display_width;
const int move_int = 5; //movement interval

char button = 6;
char led = 4;
//char accel = 
//char temp =

//------------------------------------------------------------------------------------------------------------IMAGES----------------------------------------------------------------------------//

static const unsigned char bg[] U8X8_PROGMEM = {
 0xff,0xff,0xff,0xff,0xff,0xff,0xff,0xff,0xff,0xff,0xff,0xff,0xff,0xff,0xff,
 0xff,0xff,0xff,0xff,0xff,0xff,0xff,0xff,0xff,0xff,0xff,0xff,0xff,0xff,0xff,
 0xff,0xff,0xff,0xff,0xff,0xff,0xff,0xff,0xff,0xff,0xff,0xff,0xff,0xff,0xff,
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 0xff,0xff,0xff,0xff };


static const unsigned char happy_frog_a[] U8X8_PROGMEM = {
 0xff,0xff,0xff,0xff,0xff,0xff,0xff,0xff,0xff,0xff,0xff,0xff,0xff,0xff,0xff,
 0xff,0xff,0xef,0xff,0xff,0xff,0xff,0xff,0xff,0xff,0xff,0xff,0xff,0xff,0xff,
 0xff,0xff,0xff,0xe7,0xff,0xff,0xff,0xff,0xff,0xff,0xff,0xff,0xff,0xff,0xff,
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 0xff,0xff,0xff,0xff };

static const unsigned char happy_frog_b[] U8X8_PROGMEM = {
 0xff,0xff,0xff,0xff,0xff,0xff,0xff,0xff,0xff,0xff,0xff,0xff,0xff,0xff,0xff,
 0xff,0xff,0xfb,0xff,0xff,0xff,0xff,0xff,0xff,0xff,0xff,0xff,0xff,0xff,0xff,
 0xff,0xff,0xff,0xf3,0xff,0xff,0xff,0xff,0xff,0xff,0xff,0xff,0xff,0xff,0xff,
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 0xff,0xff,0xff,0xff };

static const unsigned char buttonFrog[] U8X8_PROGMEM = {
 0xff,0xff,0xff,0xff,0xff,0xff,0xff,0xff,0xff,0xff,0xff,0xff,0xff,0xff,0xff,
 0xff,0xff,0xff,0xff,0xff,0xff,0xff,0xff,0xff,0xff,0xff,0xff,0xff,0xff,0xff,
 0xff,0xff,0xff,0xff,0xff,0xff,0xff,0xff,0xff,0xff,0xff,0xff,0xff,0xff,0xff,
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 0xff,0xff,0xff,0xff };

//---------------------------------------------------------------------------------------------------------CODING--------------------------------------------------------------------//



void setup(void) {

  u8g2.begin();
  pinMode(button, INPUT);
  pinMode(led, OUTPUT);
  tick.start(fps, AsyncDelay::MILLIS);
}

void loop() {
  if (tick.isExpired()) {
    drawFrogAnimate();
    if (animate_frame == 0)
    {
       animate_frame++;
    }
    else if (animate_frame == 1)
    {
      animate_frame--;
    }
  current_pos += move_int;
  if(current_pos > 2*display_width)
  {
    current_pos = .9*display_width;
  }
  tick.repeat();
  }

  if (digitalRead(button) == HIGH)
  {
    buttonPress();
  }

}

void drawFrogAnimate() {
  u8g2.firstPage();
  do {
    u8g2.drawXBMP(0,0, hfrog_width, hfrog_height, bg); //the background of white
    switch (animate_frame) {
      case 0:
        u8g2.drawXBMP(current_pos,0, hfrog_width, hfrog_height, happy_frog_a);
        break;
      case 1: 
        u8g2.drawXBMP(current_pos,0, hfrog_width, hfrog_height, happy_frog_b);
        break;
    }
  }
  while(u8g2.nextPage());
}

void buttonPress() {
  u8g2.drawXBMP(0,0, hfrog_width, hfrog_height, buttonFrog);
  digitalWrite(led,HIGH);
  delay(3000);

}
